## Practica 3/tareas_eventos/main/Kconfig.projbuild
```kconfig
menu "Configuración del sensor y del botón"

    config SENSOR_SAMPLE_INTERVAL
        int "Intervalo de muestreo del sensor (segundos)"
        range 1 3600
        default 5
        help
            Tiempo entre lecturas consecutivas de temperatura y humedad del SHTC3
            durante el modo de monitorización.

    config NBUTTON
        int "Intervalo de sondeo del botón (milisegundos)"
        range 10 1000
        default 20
        help
            Tiempo entre comprobaciones del estado del botón GPIO. Un valor
            bajo reduce la posibilidad de perder pulsaciones breves.

endmenu
```
